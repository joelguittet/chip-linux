## Documentation/devicetree/bindings/drm/sunxi/sun4i-drm.txt
```
Allwinner A10 Display Pipeline
==============================

The Allwinner A10 Display pipeline is composed of several components
that are going to be documented below:

TV Encoder
----------

The TV Encoder supports the composite and VGA output. It is one end of
the pipeline.

Required properties:
 - compatible: value should be "allwinner,sun4i-a10-tv-encoder".
 - reg: base address and size of memory-mapped region
 - clocks: the clocks driving the TV encoder

TCON
----

The TCON acts as a CRTC and encoder for RGB / LVDS interfaces.

Required properties:
 - compatible: value should be "allwinner,sun4i-a10-tcon".
 - reg: base address and size of memory-mapped region
 - interrupts: interrupt associated to this IP
 - clocks: phandles to the clocks feeding the TCON. Three are needed:
   - 'ahb': the interface clocks
   - 'tcon-ch0': The clock driving the TCON channel 0
   - 'tcon-ch1': The clock driving the TCON channel 0

 - clock-names: the clock names mentionned above
 - clock-output-names: Name of the pixel clock created


Display Engine Backend
----------------------

The display engine backend exposes layers and sprites to the
system. It's split into two components, the frontend and backend, the
frontend doing formats conversion, scaling, deinterlacing, while the
backend actually manages the layers.

Required properties:
  - compatible: value must be one of:
    * allwinner,sun5i-a13-display-engine

  - reg: base address and size of the memory-mapped region. Two are needed:
    * backend0: registers of the display engine backend
    * frontend0: registers of the display engine frontend
  - reg_names: the region names mentionned above.

  - interrupts: frontend interrupt phandle

  - clocks: phandles to the clocks feeding the frontend and backend
    * backend0-bus: the backend interface clock
    * backend0-mod: the backend module clock
    * backend0-ram: the backend DRAM clock
    * frontend0-bus: the frontend interface clock
    * frontend0-mod: the frontend module clock
    * frontend0-ram: the frontend DRAM clock
  - clock-names: the clock names mentionned above

  - resets: phandles to the reset controllers. Two are needed:
    * backend0: backend reset controller
    * frontend0: frontend reset controller
  - reset-names: the reset names mentionned above

  - allwinner,tcon: phandle to the TCON in our pipeline

Optional properties:
  - allwinner,tv-encoder: phandle to the TV Encoder in our pipeline
  - allwinner,panel: phandle to the panel used in our RGB interface

Example:

panel: panel {
	compatible = "olimex,lcd-olinuxino-43-ts";
};

tve: encoder@01c0a000 {
	compatible = "allwinner,sun4i-a10-tv-encoder";
	reg = <0x01c0a000 0x1000>;
	clocks = <&ahb_gates 34>;
};

tcon: lcd-controller@01c0c000 {
	compatible = "allwinner,sun4i-a10-tcon";
	reg = <0x01c0c000 0x1000>;
	interrupts = <44>;
	clocks = <&ahb_gates 36>,
		 <&tcon_ch0_clk>,
		 <&tcon_ch1_clk>;
	clock-names = "ahb",
		      "tcon-ch0",
		      "tcon-ch1";
	clock-output-names = "tcon-pixel-clock";
};

de: display-engine@01e00000 {
	compatible = "allwinner,sun5i-a13-display-engine";
	reg = <0x01e00000 0x20000>,
	      <0x01e60000 0x10000>;
	reg-names = "frontend0",
		    "backend0";
	interrupts = <47>;
	interrupt-names = "engine0";
	clocks = <&ahb_gates 46>, <&de_fe_clk>,
		 <&dram_gates 25>, <&ahb_gates 44>,
		 <&de_be_clk>, <&dram_gates 26>;
	clock-names = "frontend0-bus", "frontend0-mod",
		      "frontend0-ram", "backend0-bus",
		      "backend0-mod", "backend0-ram";
	resets = <&de_fe_clk>,
		 <&de_be_clk>;
	reset-names = "frontend0",
		      "backend0";

	allwinner,tcon = <&tcon>;
	allwinner,tv-encoder = <&tve>;
	allwinner,panel = <&panel>;
};
```

## arch/arm/configs/chippro_tiny_defconfig
```kconfig
# CONFIG_LOCALVERSION_AUTO is not set
CONFIG_KERNEL_LZO=y
# CONFIG_SWAP is not set
CONFIG_SYSVIPC=y
CONFIG_FHANDLE=y
CONFIG_IRQ_DOMAIN_DEBUG=y
CONFIG_NO_HZ=y
CONFIG_HIGH_RES_TIMERS=y
CONFIG_BLK_DEV_INITRD=y
# CONFIG_RD_GZIP is not set
# CONFIG_RD_BZIP2 is not set
# CONFIG_RD_LZMA is not set
# CONFIG_RD_XZ is not set
# CONFIG_RD_LZ4 is not set
CONFIG_CC_OPTIMIZE_FOR_SIZE=y
# CONFIG_UID16 is not set
# CONFIG_KALLSYMS is not set
# CONFIG_BUG is not set
# CONFIG_BASE_FULL is not set
# CONFIG_ADVISE_SYSCALLS is not set
CONFIG_EMBEDDED=y
# CONFIG_VM_EVENT_COUNTERS is not set
# CONFIG_SLUB_DEBUG is not set
# CONFIG_COMPAT_BRK is not set
# CONFIG_LBDAF is not set
# CONFIG_BLK_DEV_BSG is not set
CONFIG_ARCH_SUNXI=y
CONFIG_ARM_THUMBEE=y
# CONFIG_KUSER_HELPERS is not set
# CONFIG_VDSO is not set
# CONFIG_CACHE_L2X0 is not set
CONFIG_HZ_300=y
CONFIG_THUMB2_KERNEL=y
# CONFIG_CPU_SW_DOMAIN_PAN is not set
# CONFIG_COMPACTION is not set
CONFIG_CMA=y
CONFIG_FORCE_MAX_ZONEORDER=12
CONFIG_ZBOOT_ROM_TEXT=0x0
CONFIG_ZBOOT_ROM_BSS=0x0
CONFIG_VFP=y
CONFIG_NEON=y
CONFIG_KERNEL_MODE_NEON=y
# CONFIG_COREDUMP is not set
# CONFIG_SUSPEND is not set
CONFIG_DEVTMPFS=y
CONFIG_DEVTMPFS_MOUNT=y
CONFIG_DMA_CMA=y
CONFIG_CMA_SIZE_MBYTES=64
CONFIG_BRCMSTB_GISB_ARB=y
CONFIG_VEXPRESS_CONFIG=y
CONFIG_MTD=y
CONFIG_MTD_CMDLINE_PARTS=y
CONFIG_MTD_BLOCK=y
CONFIG_MTD_NAND=y
CONFIG_MTD_NAND_SUNXI=y
CONFIG_MTD_UBI=y
CONFIG_MTD_UBI_FASTMAP=y
CONFIG_MTD_UBI_BLOCK=y
CONFIG_OF_OVERLAY=y
CONFIG_BLK_DEV_RAM=y
CONFIG_BLK_DEV_RAM_COUNT=2
CONFIG_SRAM=y
# CONFIG_VEXPRESS_SYSCFG is not set
CONFIG_EEPROM_AT24=y
CONFIG_EEPROM_93CX6=y
# CONFIG_INPUT_LEDS is not set
# CONFIG_INPUT_MOUSEDEV is not set
# CONFIG_INPUT_KEYBOARD is not set
# CONFIG_INPUT_MOUSE is not set
# CONFIG_SERIO is not set
CONFIG_VT_HW_CONSOLE_BINDING=y
# CONFIG_DEVMEM is not set
# CONFIG_DEVKMEM is not set
CONFIG_SERIAL_8250=y
CONFIG_SERIAL_8250_CONSOLE=y
CONFIG_SERIAL_8250_DW=y
CONFIG_SERIAL_OF_PLATFORM=y
# CONFIG_HW_RANDOM is not set
CONFIG_I2C=y
CONFIG_I2C_CHARDEV=y
CONFIG_I2C_MUX=y
CONFIG_I2C_ARB_GPIO_CHALLENGE=y
CONFIG_I2C_MUX_PINCTRL=y
CONFIG_I2C_DESIGNWARE_PLATFORM=y
CONFIG_I2C_GPIO=y
CONFIG_I2C_SLAVE=y
CONFIG_PINCTRL_SINGLE=y
CONFIG_GPIO_SYSFS=y
CONFIG_GPIO_AXP209=y
CONFIG_GPIO_DWAPB=y
CONFIG_GPIO_GENERIC_PLATFORM=y
CONFIG_POWER_SUPPLY=y
CONFIG_AXP20X_POWER=y
CONFIG_POWER_RESET=y
CONFIG_POWER_RESET_GPIO=y
CONFIG_POWER_RESET_GPIO_RESTART=y
CONFIG_POWER_RESET_SYSCON=y
# CONFIG_HWMON is not set
CONFIG_WATCHDOG=y
CONFIG_SUNXI_WATCHDOG=y
CONFIG_MFD_AXP20X=y
# CONFIG_MFD_VEXPRESS_SYSREG is not set
CONFIG_REGULATOR=y
CONFIG_REGULATOR_FIXED_VOLTAGE=y
CONFIG_REGULATOR_COUPLED_VOLTAGE=y
CONFIG_REGULATOR_VIRTUAL_CONSUMER=y
CONFIG_REGULATOR_AXP20X=y
CONFIG_REGULATOR_GPIO=y
CONFIG_REGULATOR_PWM=y
# CONFIG_HID is not set
# CONFIG_USB_HID is not set
CONFIG_USB=y
CONFIG_USB_XHCI_HCD=y
CONFIG_USB_XHCI_PLATFORM=y
CONFIG_USB_EHCI_HCD=y
CONFIG_USB_EHCI_ROOT_HUB_TT=y
CONFIG_USB_EHCI_HCD_PLATFORM=y
CONFIG_USB_OHCI_HCD=y
CONFIG_USB_OHCI_HCD_PLATFORM=y
CONFIG_USB_MUSB_HDRC=y
CONFIG_MUSB_PIO_ONLY=y
CONFIG_USB_GPIO_VBUS=y
CONFIG_USB_ULPI=y
CONFIG_USB_GADGET=y
CONFIG_USB_CONFIGFS=y
CONFIG_NEW_LEDS=y
CONFIG_LEDS_CLASS=y
CONFIG_LEDS_GPIO=y
CONFIG_LEDS_PWM=y
CONFIG_LEDS_TRIGGERS=y
CONFIG_DMADEVICES=y
# CONFIG_IOMMU_SUPPORT is not set
CONFIG_PWM=y
CONFIG_PWM_SUN4I=y
CONFIG_GENERIC_PHY=y
# CONFIG_FILE_LOCKING is not set
# CONFIG_DNOTIFY is not set
# CONFIG_INOTIFY_USER is not set
CONFIG_TMPFS=y
CONFIG_TMPFS_POSIX_ACL=y
CONFIG_UBIFS_FS=y
CONFIG_UBIFS_FS_ADVANCED_COMPR=y
CONFIG_NLS_CODEPAGE_437=y
CONFIG_NLS_ISO8859_1=y
CONFIG_NLS_UTF8=y
CONFIG_PRINTK_TIME=y
CONFIG_DYNAMIC_DEBUG=y
CONFIG_STRIP_ASM_SYMS=y
CONFIG_DEBUG_FS=y
CONFIG_LOCKUP_DETECTOR=y
# CONFIG_SCHED_DEBUG is not set
# CONFIG_FTRACE is not set
# CONFIG_CRYPTO_ECHAINIV is not set
# CONFIG_CRYPTO_HW is not set
```

## drivers/misc/cape-manager/Kconfig
```kconfig
menuconfig CAPE_MANAGER
	bool "Cape manager support"
	default n
	depends on OF && OF_OVERLAY
	help
	  Cape Managers.
```
